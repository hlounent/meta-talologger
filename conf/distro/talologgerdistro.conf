## conf/distro/talologgerdistro.conf
```bitbake
require conf/distro/poky.conf

DISTRO = "talologgerdistro"
DISTRO_NAME = "taloLogger distro"
1ISTRO_VERSION = "1.2.2"

DISTRO_FEATURES = "${DISTRO_FEATURES_LIBC} keyboard systemd usbhost usbgadget"

# Use systemd as the init system
VIRTUAL-RUNTIME_init_manager = "systemd"

# Remove sysvinit completely
DISTRO_FEATURES_BACKFILL_CONSIDERED = "sysvinit"
VIRTUAL-RUNTIME_initscripts = ""

# Decrease logging verbosity
CMDLINE_DEBUG = "quiet"
```

## conf/layer.conf
```bitbake
# We have a conf and classes directory, add to BBPATH
BBPATH .= ":${LAYERDIR}"

# We have recipes-* directories, add to BBFILES
BBFILES += "${LAYERDIR}/recipes-*/*/*.bb ${LAYERDIR}/recipes-*/*/*.bbappend"

BBFILE_COLLECTIONS += "talologger"
BBFILE_PATTERN_talologger = "^${LAYERDIR}/"
BBFILE_PRIORITY_talologger = "1"
LAYERVERSION_talologger = "1"
LAYERSERIES_COMPAT_talologger = "sumo thud"

LICENSE_PATH += "${LAYERDIR}/files/additional-licenses"
```
